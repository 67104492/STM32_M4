#include  "OLED.h"

//驱动IC为SH1106 内存为132*64 用四线SPI比较好 三线的也行 不过不能使用硬件SPI 

//OLED的显存存放格式如下.
//[0]0 1 2 3 ... 127	
//[1]0 1 2 3 ... 127	
//[2]0 1 2 3 ... 127	
//[3]0 1 2 3 ... 127	
//[4]0 1 2 3 ... 127	
//[5]0 1 2 3 ... 127	
//[6]0 1 2 3 ... 127	
//[7]0 1 2 3 ... 127 	

#define X_WIDTH    132
#define Y_WIDTH    64
#define PAGE_GRAM  8
#define XLevelL	   0x00 //列地址的低四位 00H - 0FH
#define XLevelH	   0x10 //列地址的高四位 10H - 1FH
#define MOSI_H  GPIO_SetBits(GPIOC,GPIO_Pin_12)    //输出高电平   数据输入信号
#define MOSI_L  GPIO_ResetBits(GPIOC,GPIO_Pin_12)  //输出低电平

#define SLCK_H  GPIO_SetBits(GPIOC,GPIO_Pin_10)    //输出高电平   时钟信号
#define SLCK_L  GPIO_ResetBits(GPIOC,GPIO_Pin_10)  //输出低电平

#define CS_H    GPIO_SetBits(GPIOA,GPIO_Pin_15)    //输出高电平   片选信号
#define CS_L    GPIO_ResetBits(GPIOA,GPIO_Pin_15)  //输出低电平

//SH1106 RAM 132 X 64 bits  8PAGE/132bit 
u8  OLED_GRAM[X_WIDTH][PAGE_GRAM];//128*64显示的时候 坐标位置为 2 ~ 129 (0 1 130 131 这四个点显示不出来)

const u8 F7x8[][7] = //字库已经修改 为了适应反显模式
{
    { 0x00, 0x00, 0x00, 0x00, 0x00, 0x00, 0x00 },   // sp
    { 0x00, 0x00, 0x00, 0x2f, 0x00, 0x00, 0x00 },   // !
    { 0x00, 0x00, 0x07, 0x00, 0x07, 0x00, 0x00 },   // "
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    { 0x14, 0x14, 0x14, 0x14, 0x14, 0x14, 0x14 },   // horiz lines
};
const u8 F8X16[][16]=
{
  { 0x00,0x00,0x00,0x00,0x00,0x00,0x00,0x00,0x00,0x00,0x00,0x00,0x00,0x00,0x00,0x00 },// 0
  { 0x00,0x00,0x00,0xF8,0x00,0x00,0x00,0x00,0x00,0x00,0x00,0x33,0x30,0x00,0x00,0x00 },//!1
  { 0x00,0x10,0x0C,0x06,0x10,0x0C,0x06,0x00,0x00,0x00,0x00,0x00,0x00,0x00,0x00,0x00 },//"2
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  { 0x00,0x06,0x01,0x01,0x02,0x02,0x04,0x04,0x00,0x00,0x00,0x00,0x00,0x00,0x00,0x00 },//~94

};
const u8 F14x16_Idx[] = 
{
  "你好"
};
const u8 F14x16[] = {  

0x00,0x80,0x40,0xF8,0x06,0x40,0x30,0x1E,0xF0,0x10,0x10,0x30,0x10,0x00,
0x00,0x00,0x00,0x7F,0x20,0x18,0x07,0x40,0x7F,0x00,0x01,0x02,0x1C,0x00,//你0

0x00,0x00,0xE0,0x1E,0x10,0xF0,0x00,0x04,0x04,0xE4,0x14,0x0C,0x80,0x00,
0x00,0x44,0x27,0x18,0x0F,0x10,0x01,0x01,0x41,0x7F,0x01,0x01,0x01,0x00,//好1
};



/*-------------------------------------------------------------*/
//函数名： void LCD_PutPixel(byte x,byte y)
//功能：   GPIO模拟SPI初始化
//参数：  无
//返回：  无
/*-------------------------------------------------------------*/
void OLED_GPIO_Init(void) //OLED 软件模拟SPI初始化 无法使用硬件SPI 应为传输的只有8位和16位两个选择 四线SPI模式就可以使用硬件SPI
{	 
  GPIO_InitTypeDef  GPIOA_InitStructure;//A口结构体
  GPIO_InitTypeDef  GPIOC_InitStructure;//C口结构体
	
  RCC_AHB1PeriphClockCmd(RCC_AHB1Periph_GPIOA, ENABLE);//使能GPIOA时钟
  RCC_AHB1PeriphClockCmd(RCC_AHB1Periph_GPIOC, ENABLE);//使能GPIOC时钟
  
  GPIOA_InitStructure.GPIO_Pin = GPIO_Pin_15;//片选引脚
  GPIOA_InitStructure.GPIO_Mode = GPIO_Mode_OUT;//输出
  GPIOA_InitStructure.GPIO_OType = GPIO_OType_PP;//推挽输出
  GPIOA_InitStructure.GPIO_Speed = GPIO_Speed_100MHz;//100MHz 最高速度
  GPIOA_InitStructure.GPIO_PuPd = GPIO_PuPd_UP;//上拉
  GPIO_Init(GPIOA, &GPIOA_InitStructure);//初始化
  
  GPIOC_InitStructure.GPIO_Pin = GPIO_Pin_10|GPIO_Pin_12;//SCK MOSI 引脚
  GPIOC_InitStructure.GPIO_Mode = GPIO_Mode_OUT;//输出
  GPIOC_InitStructure.GPIO_OType = GPIO_OType_PP;//推挽输出
  GPIOC_InitStructure.GPIO_Speed = GPIO_Speed_100MHz;//100MHz 最高速度
  GPIOC_InitStructure.GPIO_PuPd = GPIO_PuPd_UP;//上拉
  GPIO_Init(GPIOC, &GPIOC_InitStructure);//初始化
  
}   
/*-------------------------------------------------------------*/
//函数名： void OLED_WrDat(u8 data)
//功能：   往OLED写数据
//参数：   data
//返回：   无
/*-------------------------------------------------------------*/
void OLED_WrDat(u8 data) //写数据 D/C=1  九位数据 D/C D7 D6 D5 D4 D3 D2 D1 D0
{
	u8 i=8;
	CS_L; //片选有效
        
        SLCK_L;//传输D/C位 先变低 传输MOSI后上升沿
        MOSI_H; //高电平 传输数据
        asm("nop");   
        SLCK_H;    //一个时钟周期
        asm("nop");   
        SLCK_L;
  while(i--)
  {
    if(data&0x80) //数据转为八位二进制 传输数据  按位或
    {
      MOSI_H;
    }
    else
    {
      MOSI_L;
    }
    
    SLCK_H;    //一个时钟周期
    asm("nop");   
    SLCK_L;
    data<<=1; //表示data左移n位(二进制)
  }
    CS_H;
}
/*-------------------------------------------------------------*/
//函数名： void OLED_WrCmd(u8 cmd)
//功能：   往OLED写命令
//参数：   cmd
//返回：   无
/*-------------------------------------------------------------*/
void OLED_WrCmd(u8 cmd) //写命令 D/C=0
{
	u8 i=8;
	CS_L; //片选有效
        
        SLCK_L;//传输D/C位 先变低 传输MOSI后上升沿
        MOSI_L; //高电平 传输命令
        asm("nop");   
        SLCK_H;    //一个时钟周期
       asm("nop");   
        SLCK_L;
        
  while(i--)
  {
    if(cmd&0x80) //数据转为八位二进制 传输数据  按位或
    {
      MOSI_H;
    }
    else
    {
      MOSI_L;
    }
    
    SLCK_H;    //一个时钟周期
    asm("nop");   
    SLCK_L;
    cmd<<=1; //表示cmd左移n位(二进制)
  }
    CS_H;
}
/*-------------------------------------------------------------*/
//函数名： void OLED_Refresh_Gram(void)
//功能：   更新显存到OLED
//参数：   无
//返回：   无
/*-------------------------------------------------------------*/
void OLED_Refresh_Gram(void)
{
    u8 i,n;		    
    for(i=0;i<8;i++)  
    {  
	OLED_WrCmd (0xB0+i);       //设置页地址 B0H - B7H
	OLED_WrCmd (XLevelL);      //设置显示位置—列低地址
	OLED_WrCmd (XLevelH);      //设置显示位置—列高地址   
	for(n=0;n<X_WIDTH;n++)OLED_WrDat(OLED_GRAM[n][i]); 
    }   
}

/*-------------------------------------------------------------*/
//函数名： void OLED_Set_Pos(u8 x, u8 y)
//功能：   设置坐标位置
//参数：   x y
//返回：   无
/*-------------------------------------------------------------*/
void OLED_Set_Pos(u8 x, u8 y)
{ 
  x=x+2;
  OLED_WrCmd(0xB0+y);              
  OLED_WrCmd(((x&0xf0)>>4)|0x10);
  OLED_WrCmd((x&0x0f)|0x00); 
}

/*-------------------------------------------------------------*/
//函数名： void OLED_Clear(void)  
//功能：   清屏函数
//参数：   mode 1 填充 0 清屏 全黑
//返回：   无
/*-------------------------------------------------------------*/
void OLED_Clear(void)  
{  
    u8 i,n;  
    for(i=0;i<8;i++)for(n=0;n<X_WIDTH;n++)OLED_GRAM[n][i]=0x00;  
    OLED_Refresh_Gram();//更新显示
        
}
/*-------------------------------------------------------------*/
//函数名： void OLED_DrawPoint(u8 x,u8 y,u8 mode)
//功能：   画一个点 通过GRAM操作 只要GRAM的内容不被覆盖就没事
//参数：   x y 已经针对SH1106X修改现实的坐标 mode 1 填充 0 清屏 全黑
//返回：   无
/*-------------------------------------------------------------*/
void OLED_DrawPoint(u8 x,u8 y,u8 mode)
{
	u8 pos,bx,temp=0;
        x=x+2;//SH1106需要对显示地址偏移
	if(x>129||y>63)return;//超出范围了.
	pos=y/8;//确定在第几页
	bx=y%8;
	temp=1<<bx;
	if( mode)OLED_GRAM[x][pos]|=temp;
	else OLED_GRAM[x][pos]&=~temp;	  
        OLED_Refresh_Gram();//更新显存
}

/*-------------------------------------------------------------*/
//函数名： void OLED_F7x8Str(u8 x,u8 y,u8 ch[],u8 mode)
//功能：   写入一组标准ASCII字符串
//参数：   （x,y），y为页范围0～7，要显示的字符串,mode(1/0,正常/反显)
//返回：   无
/*-------------------------------------------------------------*/
void OLED_F7x8Str(u8 x,u8 y,u8 ch[],u8 mode)
{     
  u8 c=0,i=0,j=0;  
  x=x+2;//针对SH1106
  while (ch[j]!='\0')
  {    
    c =ch[j]-32;           //取得偏移位置
    if(x>126){x=2;y++;}   //自动换行 换页防止溢出
    if(y>7) {y=0;}
  	for(i=0;i<7;i++) //输出完一个字符
        { 
          if(mode==1)
          {
  	     OLED_GRAM[x][y]=F7x8[c][i];//正常
          }
          else if (mode==0)
          {
            OLED_GRAM[x][y]=~F7x8[c][i];//取反
          }
  	  x+=1;//换列
        }
     j++;//字符串的第几个字符
   }
  	OLED_Refresh_Gram();//更新显存
}
/*-------------------------------------------------------------*/
//函数名： void OELD_Init(void)  SH1106驱动
//功能：   初始化函数
//参数：   无
//返回：   无
/*-------------------------------------------------------------*/
void OELD_Init(void)  
{        
   OLED_GPIO_Init();   //GPIO初始化
 
   OLED_WrCmd(0xAE);   //——关闭OLED显示       AEH - AFH  关(输入命令)/开
   OLED_WrCmd(0xD5);   //——设置时钟分频因子
   OLED_WrCmd(0x80);   //——分频设置           00H - 3FH     [3:0],分频因子;[7:4],震荡频率
   OLED_WrCmd(0xA8);   //——驱动路数设置       A8H           
   OLED_WrCmd(0x3F);   //——设置驱动路数       00H - 3FH     1/64
   OLED_WrCmd(0xD3);   //——设置显示偏移地址
   OLED_WrCmd(0x00);   //——显示偏移地址       00H ~ 3FH
   OLED_WrCmd(0x40);   //——设置显示起始线：   40H - 7FH
   OLED_WrCmd(0xAD);   //——设置电荷泵 
   OLED_WrCmd(0x8B);   //——电荷泵开/关        8AH - 8BH     8AH关闭     8BH开启
   OLED_WrCmd(0xA1);   //——段落重定义：       A0H - A1H     A0H左右反置 A1H正常
   OLED_WrCmd(0xC8);   //——扫描方向           C0H - C8H     C0H正常    C8H反向COM [N -1] to COM0
   OLED_WrCmd(0xDA);   //——设置硬件引脚          
   OLED_WrCmd(0x12);   //——引脚配置           02H - 12H    02H(Sequential) 12H(Alternative)
   OLED_WrCmd(0x81);   //——对比度模式设置：   81H
   OLED_WrCmd(0XCF);   //——对比度寄存器：     00H - FFH 256个灰度级
   OLED_WrCmd(0xD9);   //——设置预充电周期
   OLED_WrCmd(0x22);   //——充电周期设置       00H - FFH    [3:0],PHASE 1;[7:4],PHASE 2;
   OLED_WrCmd(0xDB);   //——设置VCOMH 电压倍率
   OLED_WrCmd(0x40);   //——电压倍率           00H - FFH
   OLED_WrCmd(0x32);   //——设置电荷泵电压：   30H ~ 33H    8V
   OLED_WrCmd(0xA6);   //——设置显示方式       A6H - A7H    A6H正常显示 A7H反向显示  
   OLED_Clear();
   OLED_WrCmd(0xAF);   //——开启显示
  
} 
/*-------------------------------------------------------------*/
//函数名：  void OLED_P8x16Str(u8 x,u8 y,u8 ch[],u8 mode)
//功能：   写入一组标准ASCII字符串
//参数：   显示的位置（x,y），y为页范围0～7，要显示的字符串
//返回：   无
/*-------------------------------------------------------------*/
void OLED_P8x16Str(u8 x,u8 y,u8 ch[],u8 mode)
{
 u8 c=0,i=0,j=0;  
  x=x+2;//针对SH1106
  while (ch[j]!='\0')
  {    
    c =ch[j]-32;           //取得偏移位置
    if(x>123){x=2;y=y+2;}   //自动换行 换页防止溢出
    if(y>7) {y=0;}
  	for(i=0;i<8;i++) //输出完一个字符
        { 
          if(mode==1)
          { 
  	     OLED_GRAM[x][y]=F8X16[c][i];//低八位
             OLED_GRAM[x][y+1]=F8X16[c][i+8];//高八位
          }
          else if (mode==0)
          {
             OLED_GRAM[x][y]=~F8X16[c][i];//低八位
             OLED_GRAM[x][y+1]=~F8X16[c][i+8];//高八位
          }
  	  x+=1;//换列
        }
     j++;//字符串的第几个字符
   }
  	OLED_Refresh_Gram();//更新显存
}
/*-------------------------------------------------------------*/
//函数名：  void OLED_P14x16CheStr(u8 x,u8 y,u8 ch[],u8 mode)
//功能：   输出汉字字符串
//参数：   显示的位置（x,y），y为页范围0～7，要显示的字符串 mode 正常显示或者反显
//返回：   无
/*-------------------------------------------------------------*/
void OLED_P14x16CheStr(u8 x,u8 y,u8 ch[],u8 mode)
{
	u8 wm=0,ii = 0;
	u8 adder=1; 
	x=x+2;  //针对SH1106处理
        u8 x_temp=0;//x的缓存 防止地址显示出来错位
	while(ch[ii] != '\0')//输出完汉字串
	{
  	wm = 0;
  	adder = 1;
  	while(F14x16_Idx[wm] > 129)
  	{
  	  if(F14x16_Idx[wm] == ch[ii])
  	   {
  	      if(F14x16_Idx[wm + 1] == ch[ii + 1])
  		{
  		   adder = wm * 14;
  		   break;
  		}
  	   }
  		wm += 2;			
  	}
        
  	if(x>120){x=2;y++;}
  
  	if(adder != 1)// 显示汉字					
  	{
  	
              x_temp=x;
  	     for(wm = 0;wm < 14;wm++)               
  		{
                  if (mode==1)
                  {
  		     OLED_GRAM[x_temp][y]=F14x16[adder];
                  }
                  else if (mode==0)
                  {
                     OLED_GRAM[x_temp][y]=~F14x16[adder];//反显
                  }
  		   adder += 1;//地址这块需要连续累加
                    x_temp+=1;//但是不能让x在输出高位的时候累加
  		}      
  	 
  		for(wm = 0;wm < 14;wm++)          
  		{
  		  if (mode==1)
                  {
  		     OLED_GRAM[x][y+1]=F14x16[adder];
                  }
                  else if (mode==0)
                  {
                     OLED_GRAM[x][y+1]=~F14x16[adder];//反显
                  }
  		   adder += 1;
                   x+=1;
  		}
  	}
  	else			  //显示空白字符			
  	{
  	   ii += 1;
  
            x_temp=x;
  	    for(wm = 0;wm < 16;wm++)
  		{
  		  if (mode==1)
                  {
  		     OLED_GRAM[x_temp][y]=0x00;
                  }
                  else if (mode==0)
                  {
                     OLED_GRAM[x_temp][y]=0xff;//反显
                  }
                   x_temp+=1;
  		}
  
  	    for(wm = 0;wm < 16;wm++)
  		{   		
  		  if (mode==1)
                  {
  		     OLED_GRAM[x][y+1]=0x00;
                  }
                  else if (mode==0)
                  {
                     OLED_GRAM[x][y+1]=0xff;//反显
                  }
                   x+=1;
  		}
  	}
  	   ii += 2;
	}
        OLED_Refresh_Gram();//更新显存
}
/*-------------------------------------------------------------*/
//函数名： void OLED_write_char(u8 X, u8 Y,u16 c)
//功能：   显示一个字符
//参数：   显示的位置（x,y），y为页范围0～7，要显示的字符
//返回：   无
/*-------------------------------------------------------------*/
void OLED_write_char(u8 X, u8 Y,u16 c)
{
 	 
    u8 line;
	OLED_Set_Pos(X,Y);
    c -= 32;
    for (line=0; line<6; line++)
	{
        OLED_WrDat(F7x8[c][line]);
	}
}
/*-------------------------------------------------------------*/
//函数名： void OLED_Show_Number (u8 X,u8 Y,u16 number) 
//功能：   显示四个数字
//参数：   显示的位置（x,y），y为页范围0～7，要显示的字
//返回：   无
/*-------------------------------------------------------------*/
void OLED_Show_Number (u8 X,u8 Y,u16 number) 
{
   OLED_write_char(X+6,Y, number%10000/1000+48);
   OLED_write_char(X+12,Y,number%1000/100+48);
   OLED_write_char(X+18,Y,number%100/10+48);
   OLED_write_char(X+24,Y,number%10+48); 
   
   
}

/*-------------------------------------------------------------*/
//函数名： void OLED_Write_Num(u8 X,u8 Y,u16 num,u8 N)
//功能：   显示五位要显示的数字
//参数：   显示的位置（x,y），y为页范围0～7，要显示的数字
//返回：   无
/*-------------------------------------------------------------*/
void OLED_Write_Num(u8 X,u8 Y,u16 num,u8 N)
{
   u8 line;
   u8 i=0;
   u16 n[5]={0};
   n[0]= num%10;
   n[1]=(num/10)%10;
   n[2]=(num/100)%10;
   n[3]=(num/1000)%10;
   n[4]=(num/10000)%10;
   for(i=0;i<5;i++) n[i]=n[i]+16;
     for(i=N;i>0;i--) 
      {
          OLED_Set_Pos(X+(N-i)*6,Y);//光标定位
           for (line=0; line<6; line++)
              OLED_WrDat(F7x8[n[i-1]][line]);//从ACSII码表中读取字节，然后写入液晶
  }
}